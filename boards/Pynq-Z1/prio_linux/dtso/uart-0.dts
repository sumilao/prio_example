
/dts-v1/;
/plugin/;

/{
	compatible = "xlnx,zynq-7000";

	fragment@0 {		
		target = <&amba>;

		__overlay__ {

			 xil_uart@41200000 {
			    compatible = "xlnx,axi-uartlite-1.02.a";
			    interrupt-parent = <&intc>;
				interrupts = < 0x0 0x1e 0x4 >;
				reg = <0x41200000 0x10000 >;
			    clock = <100000000>;
			};
 
		};
	};
};
