/dts-v1/;
/plugin/;

/{
	compatible = "xlnx,zynq-7000";

	fragment@0 {		
		target = <&amba>;

		__overlay__ {

			blank@43c80000 {
		    	compatible = "nada-nada_empinada";
		    	clocks = <&clkc 15>;
		    	interrupt-parent = <&xil_intc>;
		    	interrupts = <0 4>;    	
		    	reg = <0x43c80000 0x1000>;
		    	#address-cells = <1>;
		    	#size-cells = <0>;
	    	};
		};
	};
};

